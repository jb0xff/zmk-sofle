## config/west.yml
```yaml
manifest:
  remotes:
    - name: zmkfirmware
      url-base: https://github.com/zmkfirmware
      # Additional modules containing boards/shields/custom code can be listed here as well.
      # See:
      # - https://zmk.dev/docs/features/modules
      # - https://docs.zephyrproject.org/3.5.0/develop/west/manifest.html#projects
  projects:
    - name: eyelash_sofle
      url: https://github.com/a741725193/zmk-sofle
      revision: refactor
    - name: zmk
      remote: zmkfirmware
      # Pinned to the last commit before ZMK PR #3060 ("feat!: Move to zephyr v4.1") merged on 2025-12-09.
      # The eyelash_sofle board is HWMv1; Zephyr 4.1 requires HWMv2. Unpin once the board is migrated.
      revision: abb64ba316c29caddc49727ca2cac2f0ed5970c7
      import: app/west.yml
  self:
    path: config          
```
